// These arguments were used when this file was generated. They will be automatically applied on subsequent loads 
// via the GUI or CLI invocations. Run CLI with '--help' for additional information on how to override these arguments.
// @cliArgs --board "/ti/boards/CC3220SF_LAUNCHXL" --product "SimpleLinkSDK@3.20.00.06"
// @versions {"data":"2019051709","timestamp":"2019051709","tool":"1.1.792","templates":"2019051709"}

var RTOS = scripting.addModule("/ti/drivers/RTOS");
var UART = scripting.addModule("/ti/drivers/UART");
var Timer = scripting.addModule("/ti/drivers/Timer");
var Timer1 = Timer.addInstance();
var Capture = scripting.addModule("/ti/drivers/Capture");
var Capture1 = Capture.addInstance();
var GPIO = scripting.addModule("/ti/drivers/GPIO");
var GPIO1 = GPIO.addInstance();
var GPIO2 = GPIO.addInstance();
var GPIO3 = GPIO.addInstance();
var GPIO4 = GPIO.addInstance();
var GPIO5 = GPIO.addInstance();
var GPIO6 = GPIO.addInstance();
var GPIO7 = GPIO.addInstance();
var GPIO8 = GPIO.addInstance();
var GPIO9 = GPIO.addInstance();
var GPIO10 = GPIO.addInstance();
var UART1 = UART.addInstance();
var SPI = scripting.addModule("/ti/drivers/SPI");
var SPI1 = SPI.addInstance();
var Crypto = scripting.addModule("/ti/drivers/Crypto");
var Crypto1 = Crypto.addInstance();
var SimpleLinkWifi = scripting.addModule("/ti/drivers/net/wifi/SimpleLinkWifi");
var Watchdog = scripting.addModule("/ti/drivers/Watchdog");
var Watchdog1 = Watchdog.addInstance();
var Timer2 = Timer.addInstance();
var Timer3 = Timer.addInstance();
var Timer4 = Timer.addInstance();
var Timer5 = Timer.addInstance();
// Name - The C/C++ identifier used in applications as the index parameter passed to Timer runtime APIs
Timer1.$name = "DISTANCE_SENSOR_TIMER";
// Timer Type
Timer1.timerType = "32 Bits";
var Power = scripting.addModule("/ti/drivers/Power");
// Name
Power.parkPins.$name = "ti_drivers_power_PowerCC32XXPins0";
var Board = scripting.addModule("/ti/drivers/Board");
// Name
Timer1.timer.$name = "MyTimer1";
// Use Peripheral
Timer1.timer.$assign = "Timer0";
// Name - The C/C++ identifier used in applications as the index parameter passed to Capture runtime APIs
Capture1.$name = "Board_CAPTURE0";
// Name
Capture1.timer.$name = "MyTimer1";
// Use Peripheral
Capture1.timer.$assign = "Timer2";
// Assign pin
Capture1.timer.capturePin.$assign = "boosterpack.24"; // P60
// Name - The C/C++ identifier used in applications as the index parameter passed to GPIO runtime APIs
GPIO1.$name = "Board_GPIO_LED0";
// Use Hardware - Select the hardware to use, or 'none' to use available header pins
GPIO1.$hardware = system.deviceData.board.components.LED_RED;
// Name - The C/C++ identifier used in applications as the index parameter passed to GPIO runtime APIs
GPIO2.$name = "Board_GPIO0";
// Assign pin
GPIO2.gpioPin.$assign = "boosterpack.4"; // P03
// Name - The C/C++ identifier used in applications as the index parameter passed to GPIO runtime APIs
GPIO3.$name = "Board_GPIO1";
// Assign pin (ignoring conflicts)
GPIO3.gpioPin.$assignAllowConflicts = "boosterpack.14"; // P06
// Name - The C/C++ identifier used in applications as the index parameter passed to GPIO runtime APIs
GPIO4.$name = "Board_GREEN";
// Use Hardware - Select the hardware to use, or 'none' to use available header pins
GPIO4.$hardware = system.deviceData.board.components.LED_GREEN;
// Name - The C/C++ identifier used in applications as the index parameter passed to GPIO runtime APIs
GPIO5.$name = "DEBUG_0";
// Name - The C/C++ identifier used in applications as the index parameter passed to GPIO runtime APIs
GPIO6.$name = "DEBUG_1";
// Name - The C/C++ identifier used in applications as the index parameter passed to GPIO runtime APIs
GPIO7.$name = "DEBUG_2";
// Name - The C/C++ identifier used in applications as the index parameter passed to GPIO runtime APIs
GPIO8.$name = "DEBUG_3";
// Name - The C/C++ identifier used in applications as the index parameter passed to GPIO runtime APIs
GPIO9.$name = "DEBUG_4";
// Name - The C/C++ identifier used in applications as the index parameter passed to GPIO runtime APIs
GPIO10.$name = "DEBUG_STATUS";
// Name - The C/C++ identifier used in applications as the index parameter passed to UART runtime APIs
UART1.$name = "UART_USB";
// Name
UART1.uart.$name = "MyUART1";
// Use Peripheral
UART1.uart.$assign = "UART0";
var DMA = scripting.addModule("/ti/drivers/DMA");
// Name - The C/C++ identifier used in applications as the index parameter passed to SPI runtime APIs
SPI1.$name = "Board_SPI0";
// Mode - In three pin mode the SS signal is not used.
SPI1.mode = "Four Pin SS Active Low";
// Name
SPI1.spi.$name = "MySPI1";
// Assign pin
SPI1.spi.sclkPin.$assign = "boosterpack.7"; // P05
// Assign pin
SPI1.spi.misoPin.$assign = "boosterpack.28"; // P53
// Name - The C/C++ identifier used in applications as the index parameter passed to Crypto runtime APIs
Crypto1.$name = "Board_Crypto0";
// Name - The C/C++ identifier used in applications as the index parameter passed to Watchdog runtime APIs
Watchdog1.$name = "Board_WATCHDOG0";
// Name
Watchdog1.watchdog.$name = "MyWATCHDOG1";
// Name - The C/C++ identifier used in applications as the index parameter passed to Timer runtime APIs
Timer2.$name = "Board_TIMER0";
// Name
Timer2.timer.$name = "MyTimer1";
// Name - The C/C++ identifier used in applications as the index parameter passed to Timer runtime APIs
Timer3.$name = "Board_TIMER1";
// Name
Timer3.timer.$name = "MyTimer1";
// Name - The C/C++ identifier used in applications as the index parameter passed to Timer runtime APIs
Timer4.$name = "Board_TIMER2";
// Name
Timer4.timer.$name = "MyTimer1";
// Name - The C/C++ identifier used in applications as the index parameter passed to Timer runtime APIs
Timer5.$name = "TEST_TIMER";
// Name
Timer5.timer.$name = "MyTimer1";
// Suggest solution
GPIO1.gpioPin.$suggestSolution = "64";
// Suggest solution
GPIO4.gpioPin.$suggestSolution = "2";
// Suggest solution
GPIO5.gpioPin.$suggestSolution = "8";
// Suggest solution
GPIO6.gpioPin.$suggestSolution = "18";
// Suggest solution
GPIO7.gpioPin.$suggestSolution = "21";
// Suggest solution
GPIO8.gpioPin.$suggestSolution = "58";
// Suggest solution
GPIO9.gpioPin.$suggestSolution = "59";
// Suggest solution
GPIO10.gpioPin.$suggestSolution = "61";
// Suggest solution
UART1.uart.txPin.$suggestSolution = "62";
// Suggest solution
UART1.uart.rxPin.$suggestSolution = "45";
// Suggest solution
SPI1.spi.$suggestSolution = "SPI0";
// Suggest solution
SPI1.spi.mosiPin.$suggestSolution = "7";
// Suggest solution
SPI1.spi.ssPin.$suggestSolution = "50";
// Suggest solution
SPI1.spi.dmaRxChannel.$suggestSolution = "UDMA_CH30";
// Suggest solution
SPI1.spi.dmaTxChannel.$suggestSolution = "UDMA_CH31";
// Suggest solution
Watchdog1.watchdog.$suggestSolution = "WATCHDOG0";
// Suggest solution
Timer2.timer.$suggestSolution = "Timer1";
// Suggest solution
Timer3.timer.$suggestSolution = "Timer3";
// Suggest solution
Timer4.timer.$suggestSolution = "Timer1";
// Suggest solution
Timer5.timer.$suggestSolution = "Timer3";
